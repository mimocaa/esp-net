## main/Kconfig.projbuild
```kconfig
menu "Wifi Configuration"
    config WIFI_SSID
        string "SSID will be connect automatically"
        default "M13"
        help
            none.
    config WIFI_PASSWD
        string "password for login to target wifi"
        default n
        help
            none.
endmenu

menu "Http Configration"
    config DATA_BUFFER_SIZE
        int "Size for http receive buffer"
        default 2048

    config SERVER_BASE_URL
        string "The url for backend service"
        default "http://localhost"

    config HTTP_TIMEOUT_MS
        int "HTTP network timeout in ms (connect / read / write)"
        default 8000

    config HTTP_MAX_RETRIES
        int "Max attempts for one /chat request"
        default 3

    config HTTP_RETRY_DELAY_MS
        int "Delay in ms between /chat retries"
        default 2000
endmenu

menu "Spi bridge"
    config SPI2_MISO
        int "MISO pin for spi2"
        default 5

    config SPI2_MOSI
        int "MOSI pin for spi2"
        default 6
    config SPI2_SCLK
        int "clock pin for spi2"
        default 7
    config SPI2_CS
        int "CS/NSS pin for spi2 (slave)"
        default 10
    config SPI2_HANDSHAKE
        int "Handshake/ready output pin (high = a frame is ready)"
        default 4
    config SPI_FRAME_SIZE
        int "Fixed downlink SPI frame size in bytes (multiple of 4)"
        default 1280
    config SPI_RING_BYTES
        int "Downlink StreamBuffer capacity in bytes"
        default 16384
    config SPI2_HANDSHAKE_ACTIVE_HIGH
        bool "Handshake asserted level is HIGH (n = active LOW)"
        default y
    config SPI_SLAVE_TX_TIMEOUT_MS
        int "Timeout (ms) waiting for the SPI master to clock a frame"
        default 2000
endmenu

menu "Audio / VAD"
    config MIC_RING_BYTES
        int "Mic uplink StreamBuffer capacity in bytes"
        default 16384

    config VAD_START_RMS
        int "VAD speech-start RMS threshold"
        default 500

    config VAD_END_RMS
        int "VAD speech-end RMS threshold"
        default 300

    config VAD_HANGOVER_MS
        int "Silence duration (ms) before VAD declares speech end"
        default 600

    config VAD_PREROLL_MS
        int "Audio kept before speech start (ms) to avoid clipping onset"
        default 300
endmenu
```
